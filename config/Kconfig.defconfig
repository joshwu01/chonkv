## config/Kconfig.defconfig
```kconfig
# Copyright (c) 2020 Ryan Cross
# SPDX-License-Identifier: MIT

if ZMK_DISPLAY

config I2C
    default y

config SSD1306
    default y

endif # ZMK_DISPLAY
```

## config/boards/shields/chonkv/Kconfig.defconfig
```kconfig
if SHIELD_chonkv

config ZMK_KEYBOARD_NAME
    default "ChonkV"

endif

if ZMK_DISPLAY

config I2C
    default y

config SSD1306
    default y

endif
```

## config/west.yml
```yaml
manifest:
  remotes:
    - name: zmkfirmware
      url-base: https://github.com/zmkfirmware
  projects:
    - name: zmk
      remote: zmkfirmware
      revision: V0.3
      import: app/west.yml
  self:
    path: config
```
